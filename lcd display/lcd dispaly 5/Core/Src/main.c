#include "stm32f4xx_hal.h"

// LCD Pins
#define LCD_DATA_PORT GPIOC
#define RS_PIN GPIO_PIN_5
#define RW_PIN GPIO_PIN_6
#define EN_PIN GPIO_PIN_7
#define LCD_CTRL_PORT GPIOB

// Function prototypes
void LCD_Init(void);
void LCD_Command(uint8_t cmd);
void LCD_Char(char data);
void LCD_String(char *str);
void LCD_SetCursor(uint8_t row, uint8_t col);
void LCD_EnablePulse(void);
void LCD_Custom_Char(void);
void SystemClock_Config(void);
static void MX_GPIO_Init(void);

// Special Characters in CGRAM (8 bytes per character)
uint8_t alpha[8] = {0x00, 0x0E, 0x01, 0x0F, 0x11, 0x11, 0x0F, 0x00}; // α
uint8_t beta[8]  = {0x00, 0x0E, 0x11, 0x0E, 0x11, 0x11, 0x0E, 0x00}; // β
uint8_t pi[8]    = {0x00, 0x1F, 0x05, 0x05, 0x05, 0x05, 0x05, 0x00}; // π
uint8_t ohm[8]   = {0x00, 0x0E, 0x11, 0x11, 0x11, 0x0A, 0x1B, 0x00}; // Ω

int main(void)
{
    HAL_Init();
    SystemClock_Config();
    MX_GPIO_Init();
    LCD_Init();

    // Load Custom Characters
    LCD_Custom_Char();

    LCD_SetCursor(0, 0);
    LCD_String("Alpha: ");
    LCD_Char(0);

    LCD_SetCursor(0, 9);
    LCD_String("Beta: ");
    LCD_Char(1);

    LCD_SetCursor(1, 0);
    LCD_String("Pi: ");
    LCD_Char(2);

    LCD_SetCursor(1, 9);
    LCD_String("Ohm: ");
    LCD_Char(3);

    while (1);
}

// Load Custom Characters to CGRAM
void LCD_Custom_Char(void)
{
    uint8_t i;

    LCD_Command(0x40); // Set CGRAM Address

    for (i = 0; i < 8; i++) LCD_Char(alpha[i]);
    for (i = 0; i < 8; i++) LCD_Char(beta[i]);
    for (i = 0; i < 8; i++) LCD_Char(pi[i]);
    for (i = 0; i < 8; i++) LCD_Char(ohm[i]);

    LCD_Command(0x80); // Return to DDRAM
}

// Send command to LCD
void LCD_Command(uint8_t cmd)
{
    HAL_GPIO_WritePin(LCD_CTRL_PORT, RS_PIN, GPIO_PIN_RESET);
    HAL_GPIO_WritePin(LCD_CTRL_PORT, RW_PIN, GPIO_PIN_RESET);
    HAL_GPIO_WritePin(LCD_DATA_PORT, 0xFF, GPIO_PIN_RESET);
    HAL_GPIO_WritePin(LCD_DATA_PORT, cmd, GPIO_PIN_SET);
    LCD_EnablePulse();
}

// Send character to LCD
void LCD_Char(char data)
{
    HAL_GPIO_WritePin(LCD_CTRL_PORT, RS_PIN, GPIO_PIN_SET);
    HAL_GPIO_WritePin(LCD_CTRL_PORT, RW_PIN, GPIO_PIN_RESET);
    HAL_GPIO_WritePin(LCD_DATA_PORT, 0xFF, GPIO_PIN_RESET);
    HAL_GPIO_WritePin(LCD_DATA_PORT, data, GPIO_PIN_SET);
    LCD_EnablePulse();
}

// Send string to LCD
void LCD_String(char *str)
{
    while (*str) LCD_Char(*str++);
}

// Set cursor position
void LCD_SetCursor(uint8_t row, uint8_t col)
{
    uint8_t address = (row == 0) ? (0x80 + col) : (0xC0 + col);
    LCD_Command(address);
}

// Enable Pulse
void LCD_EnablePulse(void)
{
    HAL_GPIO_WritePin(LCD_CTRL_PORT, EN_PIN, GPIO_PIN_SET);
    HAL_Delay(1);
    HAL_GPIO_WritePin(LCD_CTRL_PORT, EN_PIN, GPIO_PIN_RESET);
    HAL_Delay(1);
}

// LCD Initialization (8-bit mode)
void LCD_Init(void)
{
    HAL_Delay(50);
    LCD_Command(0x38); // 8-bit mode, 2-line, 5x7 font
    LCD_Command(0x0C); // Display ON, Cursor OFF
    LCD_Command(0x06); // Auto increment cursor
    LCD_Command(0x01); // Clear display
    HAL_Delay(5);
}

// GPIO Initialization
static void MX_GPIO_Init(void)
{
    __HAL_RCC_GPIOB_CLK_ENABLE();
    __HAL_RCC_GPIOC_CLK_ENABLE();

    GPIO_InitTypeDef GPIO_InitStruct = {0};

    GPIO_InitStruct.Pin = RS_PIN | RW_PIN | EN_PIN;
    GPIO_InitStruct.Mode = GPIO_MODE_OUTPUT_PP;
    GPIO_InitStruct.Pull = GPIO_NOPULL;
    GPIO_InitStruct.Speed = GPIO_SPEED_FREQ_LOW;
    HAL_GPIO_Init(LCD_CTRL_PORT, &GPIO_InitStruct);

    GPIO_InitStruct.Pin = GPIO_PIN_All;
    HAL_GPIO_Init(LCD_DATA_PORT, &GPIO_InitStruct);
}

// System Clock Configuration
void SystemClock_Config(void)
{
    // System clock function (Generated by CubeMX)
}

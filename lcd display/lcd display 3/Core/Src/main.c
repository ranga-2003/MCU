#include "stm32f4xx_hal.h"

// Define LCD Pins
#define LCD_DATA_PORT GPIOC  // Data lines (D0-D7) connected to PC0-PC7
#define RS_PIN GPIO_PIN_5    // Register Select (PB5)
#define RW_PIN GPIO_PIN_6    // Read/Write (PB6) - Always LOW
#define EN_PIN GPIO_PIN_7    // Enable (PB7)
#define LCD_CTRL_PORT GPIOB  // Control port (RS, RW, EN)

// Function prototypes
void LCD_Command(uint8_t cmd);
void LCD_Char(char data);
void LCD_Init(void);
void LCD_String(char *str);
void LCD_EnablePulse(void);
void LCD_SetCursor(uint8_t row, uint8_t col);
void SystemClock_Config(void);
static void MX_GPIO_Init(void);

int main(void)
{
    HAL_Init();
    SystemClock_Config();
    MX_GPIO_Init();
    LCD_Init();

    // Display text on first line
    LCD_SetCursor(0, 0); // Set cursor to first row, first column
    LCD_String("Hello, STM32!");

    // Display text on second line
    LCD_SetCursor(1, 0); // Set cursor to second row, first column
    LCD_String("LCD 8-bit Mode!");

    while (1) {}
}

// Send command to LCD
void LCD_Command(uint8_t cmd)
{
    HAL_GPIO_WritePin(LCD_CTRL_PORT, RS_PIN, GPIO_PIN_RESET); // RS = 0 (Command mode)
    HAL_GPIO_WritePin(LCD_CTRL_PORT, RW_PIN, GPIO_PIN_RESET); // RW = 0 (Write mode)

    HAL_GPIO_WritePin(LCD_DATA_PORT, 0xFF, GPIO_PIN_RESET); // Clear D0-D7
    HAL_GPIO_WritePin(LCD_DATA_PORT, cmd, GPIO_PIN_SET);    // Send command to D0-D7

    LCD_EnablePulse();
}

// Send character to LCD
void LCD_Char(char data)
{
    HAL_GPIO_WritePin(LCD_CTRL_PORT, RS_PIN, GPIO_PIN_SET);  // RS = 1 (Data mode)
    HAL_GPIO_WritePin(LCD_CTRL_PORT, RW_PIN, GPIO_PIN_RESET); // RW = 0 (Write mode)

    HAL_GPIO_WritePin(LCD_DATA_PORT, 0xFF, GPIO_PIN_RESET); // Clear D0-D7
    HAL_GPIO_WritePin(LCD_DATA_PORT, data, GPIO_PIN_SET);   // Send data to D0-D7

    LCD_EnablePulse();
}

// Send string to LCD
void LCD_String(char *str)
{
    while (*str)
    {
        LCD_Char(*str++);
    }
}

// Set cursor position (row = 0 or 1, col = 0-15)
void LCD_SetCursor(uint8_t row, uint8_t col)
{
    uint8_t address;
    if (row == 0)
        address = 0x80 + col;  // 1st row
    else
        address = 0xC0 + col;  // 2nd row

    LCD_Command(address);
}

// Generate enable pulse
void LCD_EnablePulse(void)
{
    HAL_GPIO_WritePin(LCD_CTRL_PORT, EN_PIN, GPIO_PIN_SET);
    HAL_Delay(1);
    HAL_GPIO_WritePin(LCD_CTRL_PORT, EN_PIN, GPIO_PIN_RESET);
    HAL_Delay(1);
}

// Initialize LCD in 8-bit mode
void LCD_Init(void)
{
    HAL_Delay(50);

    LCD_Command(0x38); // 8-bit mode, 2-line, 5x7 font
    LCD_Command(0x0C); // Display ON, Cursor OFF
    LCD_Command(0x06); // Auto increment cursor
    LCD_Command(0x01); // Clear display
    HAL_Delay(5);
}

// Initialize GPIO
static void MX_GPIO_Init(void)
{
    __HAL_RCC_GPIOC_CLK_ENABLE();
    __HAL_RCC_GPIOB_CLK_ENABLE();

    GPIO_InitTypeDef GPIO_InitStruct = {0};

    // LCD Data Pins (D0-D7) on PC0-PC7
    GPIO_InitStruct.Pin = GPIO_PIN_0 | GPIO_PIN_1 | GPIO_PIN_2 | GPIO_PIN_3 |
                          GPIO_PIN_4 | GPIO_PIN_5 | GPIO_PIN_6 | GPIO_PIN_7;
    GPIO_InitStruct.Mode = GPIO_MODE_OUTPUT_PP;
    GPIO_InitStruct.Pull = GPIO_NOPULL;
    GPIO_InitStruct.Speed = GPIO_SPEED_FREQ_LOW;
    HAL_GPIO_Init(LCD_DATA_PORT, &GPIO_InitStruct);

    // Control Pins (RS, RW, EN) on PB5, PB6, PB7
    GPIO_InitStruct.Pin = RS_PIN | RW_PIN | EN_PIN;
    HAL_GPIO_Init(LCD_CTRL_PORT, &GPIO_InitStruct);
}

// System Clock Configuration
void SystemClock_Config(void)
{
    // System clock configuration function (Generated by CubeMX)
}
